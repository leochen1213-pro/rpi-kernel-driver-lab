/dts-v1/;
/plugin/;

/ {
	compatible = "brcm,bcm2835";

	fragment@0 {
		target = <&i2c1>;
		__overlay__ {
			#address-cells = <1>;
			#size-cells = <0>;
			status = "okay";

			lm75_demo: lm75-demo@48 {
				/*
				 * 故意用自訂的 compatible 字串，不用標準的
				 * "national,lm75"，避免核心內建的 lm75.ko
				 * 自動把這個裝置搶走，讓我們自己寫的 driver
				 * 能夠 bind 上去。
				 */
				compatible = "myvendor,lm75-demo";
				reg = <0x48>;
				status = "okay";
			};
		};
	};
};
